## package/modules/rk915/Config.in
```kconfig
config BR2_PACKAGE_RK915
	bool "Rockchip RK915 SDIO WiFi driver (XF40H, R36 Max)"
	depends on BR2_LINUX_KERNEL
	help
	  Out-of-tree driver for the Rockchip RK915 2.4 GHz SDIO WiFi chip
	  found in several RK3326 handhelds. Vendor BSP driver as ported to
	  mainline by ImanolBarba/rk915, with a small compatibility layer for
	  the 6.1 BSP kernel. Needs the rk915 MMC quirks carried in the
	  rk3326 kernel patch, and the rk915-wifi / supports-rk915 DT nodes.
```

## package/modules/rtl8821cs/Config.in
```kconfig
config BR2_PACKAGE_RTL8821CS
	bool "Realtek RTL8821CS SDIO WiFi driver (Anbernic H700)"
	depends on BR2_LINUX_KERNEL
	help
	  Out-of-tree Realtek RTL8821CS SDIO WiFi vendor driver (v5.12.0),
	  built against the sunxi 5.4 BSP kernel with its sunxi-rf power
	  glue. Used by the Anbernic H700 devices.
```

## package/system/knulli-armhf-drop/Config.in
```kconfig
config BR2_PACKAGE_KNULLI_ARMHF_DROP
	bool "knulli-armhf-drop"
	depends on BR2_aarch64
	help
	  Install a prebuilt 32-bit (armhf) userspace into /lib32 and
	  /usr/lib32, for the 32-bit emulators a 64-bit image still ships
	  (drastic and friends).

	  The payload comes from a <board>_armhf_libs build, harvested by
	  "make <board>-armhf-drop" into armhf-cache/, not from this build.
	  A missing drop fails the build rather than producing an image whose
	  32-bit emulators cannot start.

if BR2_PACKAGE_KNULLI_ARMHF_DROP

config BR2_PACKAGE_KNULLI_ARMHF_DROP_DEVICE
	string "armhf drop device"
	help
	  Which armhf-cache/drop/<name> this board installs.  The 32-bit
	  payload is NOT interchangeable between SoCs -- it carries that
	  board's Mali userspace and is built against its kernel headers --
	  so this is the board name, not an ABI profile.

endif
```

## package/system/raofflineproxy/Config.in
```kconfig
config BR2_PACKAGE_RAOFFLINEPROXY
	bool "raofflineproxy"

	help
	  System integration for RAOfflineProxy, an offline proxy for
	  RetroAchievements (offline achievement caching and casual unlock
	  queueing). Ships the service file so the proxy can be toggled in
	  EmulationStation. The app itself installs to /userdata via the
	  RAOfflineProxy installer; the service is a no-op without it.

	  https://github.com/misantronic/RAOfflineProxy
```

## package/toolchain/toolchain-optional-linaro-aarch64/Config.in
```kconfig
config BR2_TOOLCHAIN_OPTIONAL_LINARO_AARCH64
	bool "toolchain-optional-linaro-aarch64"
	depends on BR2_HOSTARCH = "x86_64"
	help
	  Toolchain for the AArch64 architecture that can be optionally used by
	  packages at compile time, from
	  http://www.linaro.org/engineering/armv8/

	  Needed by vendor BSP trees that predate modern GCC, such as the
	  RK3566 U-Boot 2017.09.
```

## package/utils/batteryplus/Config.in
```kconfig
config BR2_PACKAGE_BATTERYPLUS
	bool "batteryplus"
	depends on BR2_INSTALL_LIBSTDCPP
	help
	  Battery percentage daemon for handheld Linux systems.
```

## package/utils/ff-rumble/Config.in
```kconfig
config BR2_PACKAGE_FF_RUMBLE
	bool "ff-rumble"
	help
	  Command-line rumble utility for handhelds.
	  Automatically finds the internal controller from es_input.cfg
```

## package/utils/knulli-overlay/Config.in
```kconfig
config BR2_PACKAGE_KNULLI_OVERLAY
	bool "knulli-overlay"
	depends on !BR2_STATIC_LIBS
	help
	  GL-injected status overlay: volume, brightness, battery,
	  wifi/bluetooth, clock and emulator bezels.

	  https://github.com/knulli-cfw/knulli-overlay

comment "knulli-overlay needs a toolchain w/ dynamic library support"
	depends on BR2_STATIC_LIBS
```

## package/utils/knulli-utils/Config.in
```kconfig
config BR2_PACKAGE_KNULLI_UTILS
       bool "Knulli Utils"
       select BR2_PACKAGE_SDL2
       select BR2_PACKAGE_SDL2_IMAGE
       select BR2_PACKAGE_SDL2_TTF
       select BR2_PACKAGE_SDL2_GFX
       select BR2_PACKAGE_ZLIB
       # charger is SDL1 and only built for h700
       select BR2_PACKAGE_SDL           if BR2_PACKAGE_BATOCERA_TARGET_H700
       select BR2_PACKAGE_SDL_IMAGE     if BR2_PACKAGE_BATOCERA_TARGET_H700
       select BR2_PACKAGE_SDL_TTF       if BR2_PACKAGE_BATOCERA_TARGET_H700
       select BR2_PACKAGE_SDL_GFX       if BR2_PACKAGE_BATOCERA_TARGET_H700
       help
          Knulli utitlities like progressbar, charger, etc.
```
