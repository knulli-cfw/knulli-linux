## package/boot/uboot-a527/Config.in
```kconfig
config BR2_PACKAGE_UBOOT_A527
    bool "uboot-a527"
    depends on BR2_aarch64
    help
      U-Boot boot packages for Allwinner A527/T527 handhelds, built
      from the Tina AIOT brandy-2.0 U-Boot with the device's board dts
      and packed with the vendor monitor and scp by dragonsecboot.

      output/images/a527-boot-packages/<device>_boot_package.fex
```

## package/boot/uboot-h700/Config.in
```kconfig
config BR2_PACKAGE_UBOOT_H700
    bool "uboot-h700"
    depends on BR2_aarch64
    help
      U-Boot boot packages for Allwinner H700-based handheld devices.
      
      This package builds boot_package.fex files for various H700 devices:
      - rg-cubexx, rg28xx, rg34xx series
      - rg35xx series (h, plus, pro, sp)
      - rg40xx series (h, v)
      
      Each device gets its device tree compiled and packed with U-Boot
      components using Allwinner's dragonsecboot tool.
      
      The resulting boot packages are placed in:
      output/images/h700-boot-packages/<device>_boot_package.fex
```

## package/boot/uboot-rk3326/Config.in
```kconfig
config BR2_PACKAGE_UBOOT_RK3326
    bool "uboot files for Rockchip RK3326"
    help
        Single U-Boot image for all Rockchip RK3326 handhelds; the
        device is detected at runtime from SARADC channel 0.
```

## package/boot/uboot-t618/Config.in
```kconfig
config BR2_PACKAGE_UBOOT_T618
	bool "uboot for Unisoc UMS512 / T618"
	help
	  Vendor U-Boot for the Unisoc UMS512 (T618), built from source and
	  packed into a stock DHTB image wrapper.

	  Produces images/u-boot.img, which genimage writes to the raw partition
	  GPT-named "uboot" -- where the SPL looks for it.

	  https://github.com/beebono/u-boot-ums512
```

## package/cores/libretro-makecode-arcade/Config.in
```kconfig
config BR2_PACKAGE_LIBRETRO_MAKECODE_ARCADE
	bool "libretro-makecode-arcade"
	depends on BR2_INSTALL_LIBSTDCPP
	depends on BR2_aarch64 || BR2_x86_64
	help
	  MakeCode Arcade libretro core (unofficial).

	  Runs Microsoft MakeCode Arcade games compiled to PXT64 bytecode.
	  Cartridges must be .pxt64 images; the .png files the MakeCode editor
	  produces hold source code only and cannot be run.

	  64-bit only: the official PXT compiler emits no 32-bit bytecode and the
	  runtime's PXT32 image patching is an unimplemented upstream TODO, so a
	  32-bit build loads but cannot run anything.

	  https://github.com/whmzsu/makecode-arcade-libretro

comment "libretro-makecode-arcade needs a toolchain w/ C++, 64-bit target"
	depends on !BR2_INSTALL_LIBSTDCPP || !(BR2_aarch64 || BR2_x86_64)
```

## package/cores/libretro-super/Config.in
```kconfig
config BR2_PACKAGE_LIBRETRO_SUPER
	bool "libretro-super (all cores, built out of tree)"
	depends on BR2_PACKAGE_KNULLI_EXTERNAL_LIBRETRO_CORES
	default y if BR2_PACKAGE_KNULLI_EXTERNAL_LIBRETRO_CORES
	help
	  Install every libretro core for this board's ABI profile from
	  a prebuilt libretro-super drop, instead of compiling ~140
	  individual Buildroot packages.

	  The drop is built by "make <board>-cores-drop", not by the
	  image build, and is keyed on the ABI profile, so boards
	  sharing an ABI compile the cores once between them.  A build
	  with no drop for its profile fails and says which target to
	  run.

config BR2_PACKAGE_LIBRETRO_SUPER_DEVICE
	string "device name"
	depends on BR2_PACKAGE_LIBRETRO_SUPER
	help
	  Which devices/<name>.device file describes this board.  That
	  file names the ABI profile the board consumes, and hence which
	  drop it installs.

	  Boards sharing a profile share the compiled cores: h700, a133,
	  rk3326 and rk3576 all map to aarch64-v8a.
```

## package/emulators/aethersx2/Config.in
```kconfig
config BR2_PACKAGE_AETHERSX2
    bool "aethersx2"
    depends on BR2_aarch64
    select BR2_PACKAGE_LIBFUSE
    select BR2_PACKAGE_LIBGPG_ERROR
    select BR2_PACKAGE_XZ
    select BR2_PACKAGE_LIBPCAP
    select BR2_PACKAGE_BATOCERA_QT6
    help
      AetherSX2 - ARM PS2 Emulator (Standalone AppImage)
      
      High-performance PlayStation 2 emulator for ARM64 devices.
      
      https://github.com/ROCKNIX/packages

comment "aethersx2 needs aarch64 and Qt6"
    depends on !BR2_aarch64 || !BR2_PACKAGE_BATOCERA_QT6
```

## package/emulators/amiberry-lite/Config.in
```kconfig
config BR2_PACKAGE_AMIBERRY_LITE
    bool "amiberry-lite"
    select BR2_PACKAGE_SDL2
    select BR2_PACKAGE_SDL2_IMAGE
    select BR2_PACKAGE_SDL2_TTF
    select BR2_PACKAGE_MPG123
    select BR2_PACKAGE_LIBMPEG2
    select BR2_PACKAGE_FLAC
    select BR2_PACKAGE_LIBPNG
    select BR2_PACKAGE_LIBSERIALPORT
    select BR2_PACKAGE_LIBPORTMIDI
    select BR2_PACKAGE_ZLIB
    select BR2_PACKAGE_ZSTD
    select BR2_PACKAGE_LIBENET
    help
    	The SDL2 branch of amiberry, kept lean for lower powered ARM
    	devices.  Installs alongside amiberry, which is SDL3.

    	https://github.com/BlitterStudio/amiberry-lite
```

## package/emulators/azahar/Config.in
```kconfig
config BR2_PACKAGE_AZAHAR
    bool "azahar"            
    select BR2_PACKAGE_BOOST
    select BR2_PACKAGE_BOOST_SERIALIZATION
    select BR2_PACKAGE_BOOST_IOSTREAMS
    select BR2_PACKAGE_BOOST_REGEX
    select BR2_PACKAGE_BOOST_LOCALE
    select BR2_PACKAGE_BOOST_CONTAINER
    select BR2_PACKAGE_FDK_AAC
    select BR2_PACKAGE_FFMPEG  
    select BR2_PACKAGE_FMT
    select BR2_PACKAGE_OPENAL
    select BR2_PACKAGE_SDL2
    select BR2_PACKAGE_BATOCERA_QT6
    select BR2_PACKAGE_VULKAN_HEADERS    if BR2_PACKAGE_BATOCERA_VULKAN
    select BR2_PACKAGE_VULKAN_LOADER     if BR2_PACKAGE_BATOCERA_VULKAN
    help
      Azahar is a Citra fork and emulator for the Nintendo 3DS.
      
      https://github.com/azahar-emu/azahar
```

## package/emulators/dsperate/Config.in
```kconfig
config BR2_PACKAGE_DSPERATE
	bool "dsperate"
	select BR2_PACKAGE_SDL2
	help
	  A Nintendo DS emulator reimplementing DraStic's JIT and NEON
	  rendering techniques with melonDS-grade accuracy.  The
	  recompiler and the NEON kernels are aarch64 only.

	  https://github.com/beebono/DSperate
```

## package/emulators/knulli-emulators-drop/Config.in
```kconfig
config BR2_PACKAGE_KNULLI_EMULATORS_DROP
	bool "knulli emulators drop (standalone emulators and ports, built out of tree)"
	depends on BR2_PACKAGE_KNULLI_EXTERNAL_EMULATORS
	default y if BR2_PACKAGE_KNULLI_EXTERNAL_EMULATORS
	help
	  Install the standalone emulators and ports from a prebuilt drop
	  instead of compiling them here.

	  The drop is keyed on the ABI profile, so every board sharing an ABI
	  installs the same binaries.  What the payload needs from the image is
	  checked against this board's rootfs once it is complete, so a board
	  whose config does not provide something fails the build rather than
	  shipping an emulator that dies at launch.

config BR2_PACKAGE_KNULLI_EMULATORS_DROP_DEVICE
	string "device name"
	depends on BR2_PACKAGE_KNULLI_EMULATORS_DROP
	default BR2_PACKAGE_LIBRETRO_SUPER_DEVICE
	help
	  Which devices/<name>.device file describes this board.  That file
	  names the ABI profile, and hence which drop to install.

	  It defaults to the device already set for libretro-super, because the
	  device -> profile map is one file shared by both: cores and emulators
	  cannot disagree about which ABI a board is.
```

## package/emulators/mupen64plus-pow2/Config.in
```kconfig
config BR2_PACKAGE_MUPEN64PLUS_POW2
	bool "mupen64plus-pow2"
	depends on BR2_aarch64
	depends on BR2_INSTALL_LIBSTDCPP
	select BR2_PACKAGE_SDL2
	select BR2_PACKAGE_LIBPNG
	select BR2_PACKAGE_ZLIB
	help
	  One static Mupen64Plus executable for aarch64 handhelds: the
	  core, the console front-end and the foir (software RDP),
	  arMLEt (RSP), altru (audio) and suxty (input, in-game menu)
	  plugins, linked with LTO.

	  https://github.com/beebono/mupen64plus-pow2
```

## package/emulators/noods/Config.in
```kconfig
config BR2_PACKAGE_NOODS
    bool "noods"
    depends on BR2_INSTALL_LIBSTDCPP
    depends on BR2_TOOLCHAIN_HAS_THREADS
    depends on !BR2_STATIC_LIBS
    depends on BR2_PACKAGE_HAS_LIBEGL
    depends on BR2_PACKAGE_HAS_LIBGLES
    select BR2_PACKAGE_SDL2
    select BR2_PACKAGE_LIBPNG
    help
      NooDS - A (hopefully!) speedy Nintendo DS emulator
      
      NooDS is an experimental Nintendo DS emulator written in C++
      with speed in mind. It aims to be fast and accurate while
      maintaining a clean and readable codebase.
      
      Configured for OpenGL ES (GLES) support.
      
      https://github.com/Hydr8gon/NooDS

comment "noods needs a toolchain w/ C++, threads, dynamic library, EGL, GLES"
    depends on !BR2_INSTALL_LIBSTDCPP || !BR2_TOOLCHAIN_HAS_THREADS || BR2_STATIC_LIBS || !BR2_PACKAGE_HAS_LIBEGL || !BR2_PACKAGE_HAS_LIBGLES
```

## package/emulators/yabasanshiro/Config.in
```kconfig
config BR2_PACKAGE_YABASANSHIRO
	bool "yabasanshiro"
	select BR2_PACKAGE_SDL2
	select BR2_PACKAGE_OPENAL
	select BR2_PACKAGE_BOOST
	select BR2_PACKAGE_BOOST_DATE_TIME
	select BR2_PACKAGE_BOOST_FILESYSTEM
	select BR2_PACKAGE_BOOST_LOCALE
	select BR2_PACKAGE_BOOST_SYSTEM
	select BR2_PACKAGE_ZLIB
	select BR2_PACKAGE_LIBPNG

	help
	  uoYabause is a unofficial port of
	  Yabause SEGA Saturn Emulator.

	  http://www.uoyabause.org/
```

## package/firmwares/qualcomm-firmware/Config.in
```kconfig
config BR2_PACKAGE_QUALCOMM_FIRMWARE
	bool "qualcomm firmware"
	select BR2_PACKAGE_ALLLINUXFIRMWARES

	help
	  Vendor firmware for Qualcomm handhelds: ADSP/CDSP/VPU images,
	  sound topologies and the WCN7850 wifi blobs.
```

## package/gpu/mali-g57-sunxi/Config.in
```kconfig
config BR2_PACKAGE_MALI_G57_SUNXI
	bool "mali-g57-sunxi"
	depends on BR2_aarch64
	select BR2_PACKAGE_LIBDRM
	select BR2_PACKAGE_HAS_LIBEGL
	select BR2_PACKAGE_HAS_LIBGLES
	select BR2_PACKAGE_HAS_LIBMALI
	select BR2_PACKAGE_HAS_LIBOPENCL
	select BR2_PACKAGE_HAS_LIBVULKAN
	select BR2_PACKAGE_HAS_LIBGBM
	select BR2_PACKAGE_LIBGBM_HAS_FEATURE_DMA_BUF
	select BR2_PACKAGE_LIBGBM_HAS_FEATURE_FORMAT_MODIFIER_PLANE_COUNT

	help
	  Install the binary user-space components for the MALI G57 (VALHALL) SUNXI 
	  GPU.

if BR2_PACKAGE_MALI_G57_SUNXI

config BR2_PACKAGE_PROVIDES_LIBEGL
	default "mali-g57-sunxi"

config BR2_PACKAGE_PROVIDES_LIBGLES
	default "mali-g57-sunxi"

config BR2_PACKAGE_PROVIDES_LIBMALI
	default "mali-g57-sunxi"

config BR2_PACKAGE_PROVIDES_LIBOPENCL
	default "mali-g57-sunxi"

config BR2_PACKAGE_PROVIDES_LIBGBM
	default "mali-g57-sunxi"

endif

comment "mali-g57-sunxi"
```

## package/gpu/mali-kbase-sunxi/Config.in
```kconfig
config BR2_PACKAGE_MALI_KBASE_SUNXI
	bool "mali-kbase-sunxi"
	depends on BR2_LINUX_KERNEL
	help
	  Mali kbase kernel driver taken from the Allwinner BSP kernel's own
	  modules/gpu tree and built against this board's kernel.

	  Unlike mali-kbase, the version is whatever the BSP ships (r20p0-01rel0
	  on the orangepi H618 tree), with the sunxi platform glue, and it has
	  to match the userspace blob: mali-g31-fbdev is r20p0-01rel0 as well.

comment "mali-kbase-sunxi needs a Linux kernel to be built"
	depends on !BR2_LINUX_KERNEL
```

## package/gpu/mali-kbase/Config.in
```kconfig
config BR2_PACKAGE_MALI_KBASE
	bool "mali-kbase"
	depends on BR2_LINUX_KERNEL
	help
	  ARM Mali Midgard/Bifrost kbase kernel driver, built out of tree
	  against this board's kernel.

	  The userspace side is a separate package (mali-libs); this is only
	  the kernel module the blob talks to.

	  https://github.com/beebono/mali_kbase

comment "mali-kbase needs a Linux kernel to be built"
	depends on !BR2_LINUX_KERNEL
```

## package/gpu/mali-libs/Config.in
```kconfig
config BR2_PACKAGE_MALI_LIBS
    bool "mali-libs"
    depends on BR2_PACKAGE_HAS_UDEV
    depends on BR2_TOOLCHAIN_HAS_THREADS
    depends on !BR2_STATIC_LIBS
    depends on BR2_INSTALL_LIBSTDCPP
    depends on BR2_TOOLCHAIN_GCC_AT_LEAST_4_9
    # no 'depends on WAYLAND': it closes a kconfig cycle back through
    # cog/wpewebkit to HAS_LIBGLES, which this package provides.  knulli-system
    # selects wayland unconditionally, so the dependency was always satisfied.
    select BR2_PACKAGE_LIBDRM
    help
      ARM Mali GPU userspace driver for Rockchip SoCs.
      
      Supports Mali Bifrost G52 for RK3566/RK3568.
      Works with both armhf (32-bit) and aarch64 (64-bit).
      
      https://github.com/knulli-cfw/libmali

if BR2_PACKAGE_MALI_LIBS

config BR2_PACKAGE_MALI_LIBS_PROVIDES_EGL
    bool "Provides EGL"
    default y
    select BR2_PACKAGE_HAS_LIBEGL
    help
      Select this if mali-libs should provide EGL.

config BR2_PACKAGE_MALI_LIBS_PROVIDES_GLES
    bool "Provides OpenGL ES"
    default y
    select BR2_PACKAGE_HAS_LIBGLES
    help
      Select this if mali-libs should provide OpenGL ES.

config BR2_PACKAGE_MALI_LIBS_PROVIDES_GBM
    bool "Provides GBM"
    default y
    select BR2_PACKAGE_HAS_LIBGBM
    help
      Select this if mali-libs should provide GBM.

# Virtual package provider declarations
if BR2_PACKAGE_MALI_LIBS_PROVIDES_EGL
config BR2_PACKAGE_PROVIDES_LIBEGL
    default "mali-libs"
endif

if BR2_PACKAGE_MALI_LIBS_PROVIDES_GLES
config BR2_PACKAGE_PROVIDES_LIBGLES
    default "mali-libs"
endif

if BR2_PACKAGE_MALI_LIBS_PROVIDES_GBM
config BR2_PACKAGE_PROVIDES_LIBGBM
    default "mali-libs"
endif

endif

comment "libmali needs udev, toolchain w/ threads, dynamic library, C++, gcc >= 4.9"
    depends on !BR2_PACKAGE_HAS_UDEV || !BR2_TOOLCHAIN_HAS_THREADS || \
        BR2_STATIC_LIBS || !BR2_INSTALL_LIBSTDCPP || \
        !BR2_TOOLCHAIN_GCC_AT_LEAST_4_9
```

## package/gpu/powervr-ge8300-driver/Config.in
```kconfig
config BR2_PACKAGE_POWERVR_GE8300_DRIVER
	bool "powervr-ge8300-driver"
	depends on BR2_aarch64
	select BR2_PACKAGE_HAS_LIBEGL
	select BR2_PACKAGE_HAS_LIBGLES
	select BR2_PACKAGE_HAS_LIBGBM
        select BR2_PACKAGE_HAS_LIBOPENCL
        select BR2_PACKAGE_HAS_LIBVULKAN

	help
	  Install the binary user-space components for the PowerVR GE8300
	  GPU. This package requires a kernel with the powervrkm
	  GPU Kernel Drivers enabled.

if BR2_PACKAGE_POWERVR_GE8300_DRIVER

config BR2_PACKAGE_PROVIDES_LIBEGL
	default "powervr-ge8300-driver"

config BR2_PACKAGE_PROVIDES_LIBGLES
	default "powervr-ge8300-driver"

config BR2_PACKAGE_PROVIDES_LIBGBM
	default "powervr-ge8300-driver"

config BR2_PACKAGE_PROVIDES_LIBOPENCL
	default "powervr-ge8300-driver"

endif

comment "powervr-ge8300-driver"
```

## package/gpu/powervr-ge8300-km/Config.in
```kconfig
config BR2_PACKAGE_POWERVR_GE8300_KM
	bool "powervr-ge8300-km"
	depends on BR2_LINUX_KERNEL
	help
	  PowerVR Rogue DDK 1.19 kernel modules (pvrsrvkm, dc_sunxi) for
	  the GE8300 in the Allwinner A133, built from source against the
	  kernel. Matches the powervr-ge8300-driver userspace.

	  https://github.com/pocketforge-os/gpu-km-tsp
```

## package/gpu/powervr-present-layer/Config.in
```kconfig
config BR2_PACKAGE_POWERVR_PRESENT_LAYER
	bool "powervr-present-layer"
	depends on BR2_PACKAGE_POWERVR_GE8300_DRIVER
	select BR2_PACKAGE_VULKAN_HEADERS
	select BR2_PACKAGE_VULKAN_LOADER
	help
	  Implicit Vulkan layer working around the PowerVR Rogue
	  VK_KHR_display present path, which latches the flip one
	  vblank after vkQueuePresentKHR returns.  With only two
	  swapchain images that leaves no free buffer, so applications
	  render into the image being scanned out.  The layer gives
	  them private images and copies into the swapchain at present.

	  Set KNULLI_DISABLE_POWERVR_PRESENT_LAYER=1 to bypass it.
```

## package/gpu/vulkan-wsi-layer/Config.in
```kconfig
config BR2_PACKAGE_VULKAN_WSI_LAYER
	bool "vulkan-wsi-layer"
	depends on BR2_INSTALL_LIBSTDCPP
	select BR2_PACKAGE_LIBDRM
	select BR2_PACKAGE_WAYLAND
	select BR2_PACKAGE_WAYLAND_PROTOCOLS
	select BR2_PACKAGE_VULKAN_HEADERS
	select BR2_PACKAGE_VULKAN_LOADER
	help
	  Arm's Vulkan window system integration layer, built from source
	  for Wayland.  Replaces the prebuilt layer bundled with the Mali
	  blob, which can only present through Weston's mali_buffer_sharing
	  and fails to create a swapchain on wlroots compositors (labwc).

	  https://gitlab.freedesktop.org/mesa/vulkan-wsi-layer
```
